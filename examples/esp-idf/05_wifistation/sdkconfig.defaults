## examples/esp-idf/05_wifistation/sdkconfig.defaults
```kconfig
CONFIG_IDF_TARGET="esp32p4"
# CONFIG_ESP32P4_SELECTS_REV_LESS_V3 is not set
CONFIG_ESP32P4_REV_MIN_300=y
CONFIG_ESPTOOLPY_FLASHSIZE_32MB=y
CONFIG_ESP_WIFI_SOFTAP_SUPPORT=n
```

## examples/esp-idf/06_i2s_codec/main/Kconfig.projbuild
```kconfig
menu "Example Configuration"

    choice EXAMPLE_MODE
        prompt "Example mode"
        default EXAMPLE_MODE_MUSIC
        help
            Select example work mode

        config EXAMPLE_MODE_MUSIC
            bool "music"
        config EXAMPLE_MODE_ECHO
            bool "microphone-to-speaker echo"
    endchoice

    config EXAMPLE_MIC_GAIN_DB
        int "Microphone gain (dB)"
        depends on EXAMPLE_MODE_ECHO
        range 0 37
        default 24

    config EXAMPLE_VOICE_VOLUME
        int "Voice volume"
        range 0 100
        default 60
        help
            Set voice volume

endmenu
```

## examples/esp-idf/12_usb_extend_screen/components/usb_device_uac/Kconfig
```kconfig
menu "USB Device UAC Configuration"

    if !USB_DEVICE_UAC_AS_PART
        config UAC_TUSB_VID
            hex "USB Device VID"
            default 0x303A

        config UAC_TUSB_PID
            hex "USB Device PID"
            default 0x8000

        config UAC_TUSB_MANUFACTURER
            string "USB Device Manufacturer"
            default "Espressif"

        config UAC_TUSB_PRODUCT
            string "Product Name"
            default "ESP UAC Device"

        config UAC_TUSB_SERIAL_NUM
            string "Product ID"
            default "12345678"

        choice UAC_TINYUSB_RHPORT
            prompt "TinyUSB Root Port"
            default UAC_TINYUSB_RHPORT_HS if IDF_TARGET_ESP32P4
            default UAC_TINYUSB_RHPORT_FS
            help
                Allows set the USB PHY Controller for TinyUSB: HS (USB OTG2.0 PHY for HighSpeed)

            config UAC_TINYUSB_RHPORT_HS
                depends on IDF_TARGET_ESP32P4
                bool "High Speed"

            config UAC_TINYUSB_RHPORT_FS
                bool "Full Speed"
        endchoice
    endif

    # Insert UAC config
    orsource "./Kconfig.uac"

endmenu
```

## examples/esp-idf/18_mp4_player/main/Kconfig.projbuild
```kconfig
menu "MP4 Player Configuration"

    menu "Video File Configuration"
        config MP4_FILENAME
            string "Video File Name"
            default "test_video.mp4"
            help
                Name of the video file to be played.
    endmenu

    menu "Audio Decoder Configuration"

        config AUDIO_DEC_FLAC_ENABLE
            bool "Enable FLAC Decoder"
            default n
            help
                Enable FLAC audio decoder support.
                FLAC (Free Lossless Audio Codec) is a lossless audio compression format.

        config AUDIO_DEC_OPUS_ENABLE
            bool "Enable OPUS Decoder"
            default n
            help
                Enable OPUS audio decoder support.
                Opus is a lossy audio coding format developed for internet streaming.

        config AUDIO_DEC_VORBIS_ENABLE
            bool "Enable VORBIS Decoder"
            default n
            help
                Enable Vorbis audio decoder support.
                Vorbis is a free and open-source lossy audio compression format.

        config AUDIO_DEC_ADPCM_ENABLE
            bool "Enable ADPCM Decoder"
            default n
            help
                Enable ADPCM (Adaptive Differential Pulse Code Modulation) audio decoder support.
                ADPCM is a variant of PCM that encodes the differences between samples.

    endmenu

endmenu
```
