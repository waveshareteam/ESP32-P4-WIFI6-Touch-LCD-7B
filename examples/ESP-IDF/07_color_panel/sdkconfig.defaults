## examples/ESP-IDF/07_color_panel/sdkconfig.defaults
```kconfig
CONFIG_IDF_TARGET="esp32p4"
CONFIG_ESP32P4_SELECTS_REV_LESS_V3=y
CONFIG_ESP32P4_REV_MIN_1=y
CONFIG_ESPTOOLPY_FLASHMODE_QIO=y
CONFIG_COMPILER_OPTIMIZATION_PERF=y
CONFIG_SPIRAM=y
CONFIG_SPIRAM_SPEED_200M=y
CONFIG_ESP_TASK_WDT_EN=n
CONFIG_FREERTOS_HZ=1000
CONFIG_FREERTOS_TIMER_TASK_STACK_DEPTH=4096
CONFIG_IDF_EXPERIMENTAL_FEATURES=y
```

## examples/esp-idf/14_twai_transmit/main/Kconfig.projbuild
```kconfig
menu "Example Configuration"

    config EXAMPLE_TX_GPIO_NUM
        int "TX GPIO number"
        default 22
        help
            This option selects the GPIO pin used for the TX signal. Connect the
            TX signal to your transceiver.

    config EXAMPLE_RX_GPIO_NUM
        int "RX GPIO number"
        default 21
        help
            This option selects the GPIO pin used for the RX signal. Connect the
            RX signal to your transceiver.

endmenu
```
